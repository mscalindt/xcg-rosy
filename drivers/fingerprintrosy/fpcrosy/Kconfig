## drivers/fingerprintrosy/fpcrosy/Kconfig
```kconfig
config FINGERPRINT_FPC1020_ROSY
	tristate "FingerPrint Cards fingerprint driver support"
	depends on FINGERPRINT_ROSY
	help
	  Say Y here to enable FingerPrint Cards (FPC1020) fingerprint driver support.
```

## drivers/fingerprintrosy/goodixrosy/Kconfig
```kconfig
config FINGERPRINT_GOODIX_GF3208_ROSY
	tristate "generic goodix fingerprint driver"
	depends on FINGERPRINT_ROSY
	help
	  Say Y here to enable Goodix (GF_3208) fingerprint driver support.
```

## drivers/rosy/Kconfig
```kconfig
#
# ROSY drivers configuration
#

menu "Drivers for ROSY"

source "drivers/rosy/fingerprint/Kconfig"

source "drivers/rosy/touchscreen/Kconfig"

source "drivers/rosy/led/Kconfig"

source "drivers/rosy/soc/Kconfig"

source "drivers/rosy/sound/Kconfig"

config ARM_DT_OVERLAY_ROSY
	bool "ROSY DT overlay"
	select CONFIG_ARCH_SDM450
	help
	  Say Y here to enable ROSY DT overlay.

	  If unsure, say Y.

config LAST_KMSG_ROSY
	bool "Last kernel messages interface"
	select PSTORE
	select PSTORE_CONSOLE
	help
	  Say Y here to enable pstore interface used for storing the
	  last kernel messages. The interface is located in
	  /proc/last_kmsg

	  If unsure, say Y.

endmenu
```

## drivers/rosy/fingerprint/Kconfig
```kconfig
menuconfig FINGERPRINT_ROSY
	bool "Fingerprint drivers"
	help
	  Say Y here, and a list of supported fingerprint drivers will be
	  displayed. This option doesn't affect the kernel.

	  If unsure, say Y.

if FINGERPRINT_ROSY

source "drivers/rosy/fingerprint/fpc/Kconfig"

source "drivers/rosy/fingerprint/goodix/Kconfig"

endif
```

## drivers/rosy/fingerprint/fpc/Kconfig
```kconfig
config FPC1020_ROSY
	tristate "FPC1020 fingerprint driver"
	depends on FINGERPRINT_ROSY
	help
	  Say Y here to compile fingerprint drivers for FingerPrint Cards
	  FPC1020.

	  If unsure, say Y.
```

## drivers/rosy/fingerprint/goodix/Kconfig
```kconfig
config GF3208_ROSY
	tristate "GF3208 fingerprint driver"
	depends on FINGERPRINT_ROSY
	help
	  Say Y here to compile fingerprint drivers for Goodix GF3208.

	  If unsure, say Y.
```

## drivers/rosy/led/Kconfig
```kconfig
menuconfig LED_ROSY
	bool "LED drivers"
	help
	  Say Y here, and a list of supported LED drivers will be
	  displayed. This option doesn't affect the kernel.

	  If unsure, say Y.

if LED_ROSY

config AW2013_ROSY
	tristate "AW2013 LED driver"
	depends on LED_ROSY
	help
	  Say Y here to compile LED drivers for AWINIC 2013 (aw2013).

	  If unsure, say Y.

endif
```

## drivers/rosy/pstore/Kconfig
```kconfig
menuconfig PSTORE_ROSY
	bool "Pstore drivers"
	select PSTORE
	select PSTORE_RAM
	help
	  Say Y here, and a list of supported persistent store (pstore)
	  drivers will be displayed. This option affects the kernel.

	  If unsure, say Y.

if PSTORE_ROSY

config LAST_KMSG_ROSY
	bool "Last kernel messages interface"
	depends on PSTORE_ROSY
	select PSTORE_CONSOLE
	help
	  Say Y here to enable pstore interface used for storing the
	  last kernel messages. The interface is located in
	  /proc/last_kmsg

	  If unsure, say N.

endif
```

## drivers/rosy/sound/Kconfig
```kconfig
menuconfig SOUND_ROSY
	bool "Sound drivers"
	help
	  Say Y here, and a list of supported sound drivers will be
	  displayed. This option doesn't affect the kernel.

	  If unsure, say Y.

if SOUND_ROSY

config AW87319_ROSY
	tristate "AW87319 sound driver"
	depends on SOUND_ROSY
	help
	  Say Y here to compile sound drivers for AWINIC 87319 ASoc
	  Speaker PA.

	  If unsure, say Y.

endif
```

## drivers/rosy/touchscreen/FT8006m/Kconfig
```kconfig
config FT8006M_ROSY
	tristate "FT8006M touchscreen driver"
	depends on TOUCHSCREEN_ROSY
	help
	  Say Y here to compile touchscreen drivers for FocalTech FT8006M.

	  If unsure, say Y.
```

## drivers/rosy/touchscreen/FT8716/Kconfig
```kconfig
config FT8716_ROSY
	tristate "FT8716 touchscreen driver"
	depends on TOUCHSCREEN_ROSY
	help
	  Say Y here to compile touchscreen drivers for FocalTech FT8716.

	  If unsure, say Y.
```

## drivers/rosy/touchscreen/Kconfig
```kconfig
menuconfig TOUCHSCREEN_ROSY
	bool "Touchscreen drivers"
	select I2C
	help
	  Say Y here, and a list of supported touchscreen drivers will be
	  displayed. This option doesn't affect the kernel.

	  If unsure, say Y.

if TOUCHSCREEN_ROSY

source "drivers/rosy/touchscreen/FT8006m/Kconfig"

source "drivers/rosy/touchscreen/FT8716/Kconfig"

endif
```
