#include "msm8953-audio_rosy.dtsi"
#include "msm8953-camera-sensor-qrd_rosy.dtsi"
#include "msm8953-pinctrl_rosy.dtsi"
#include "msm8953-pm_rosy.dtsi"
#include "msm8953-qrd_rosy.dtsi"
#include "msm8953-regulator_rosy.dtsi"
#include "msm8953_rosy.dtsi"
#include "msm-pm8953_rosy.dtsi"
#include "msm-pmi8940_rosy.dtsi"
#include "sdm450_rosy.dtsi"
